## Kconfig
```kconfig
menu "MicroLink Configuration"

    config MICROLINK_ENABLED
        bool "Enable MicroLink Tailscale VPN"
        default y
        help
            Enable MicroLink, a Tailscale-compatible VPN client for ESP32.

    config MICROLINK_MAX_PEERS
        int "Maximum number of peers"
        default 16
        range 1 64
        help
            Maximum number of Tailscale peers to track. Each peer uses ~200 bytes.

    config MICROLINK_MAX_ENDPOINTS
        int "Maximum endpoints per peer"
        default 8
        range 2 16
        help
            Maximum number of network endpoints per peer.

    config MICROLINK_ENABLE_DERP
        bool "Enable DERP relay support"
        default y
        help
            Enable DERP (Designated Encrypted Relay for Packets) for NAT traversal.
            Recommended for reliable connectivity behind NAT.

    config MICROLINK_ENABLE_DISCO
        bool "Enable DISCO path discovery"
        default y
        help
            Enable DISCO protocol for path optimization and direct P2P connections.

    config MICROLINK_ENABLE_STUN
        bool "Enable STUN NAT discovery"
        default y
        help
            Enable STUN client for discovering public IP and port mapping.

    config MICROLINK_HEARTBEAT_INTERVAL_MS
        int "Heartbeat interval (ms)"
        default 25000
        range 10000 60000
        help
            Interval between coordination server heartbeats.
            Tailscale requires heartbeats every 25-30 seconds to maintain "online" status.

    config MICROLINK_DERP_REGION
        int "Default DERP region ID"
        default 9
        range 1 99
        help
            Default DERP region to use. Common regions:
            1=NYC, 2=SF, 9=Dallas, 10=Seattle, 11=Singapore, 14=Sydney

    config MICROLINK_DERP_DYNAMIC_DISCOVERY
        bool "Enable dynamic DERP region discovery"
        default n
        help
            When enabled, MicroLink will parse the DERPMap from the Tailscale
            MapResponse and use available regions dynamically. This is useful
            if your tailnet has a custom derpMap configuration that disables
            certain regions.

            When disabled (default), MicroLink uses the hardcoded DERP server
            configured by MICROLINK_DERP_REGION. This is preferred when:
            - Using your own self-hosted DERP server
            - You want deterministic DERP selection
            - Your tailnet uses default Tailscale DERP configuration

    config MICROLINK_COORD_BUFFER_SIZE_KB
        int "Coordination buffer size (KB)"
        default 64
        range 16 128
        help
            Size of the buffer used for MapResponse parsing (in KB).

            For ESP32-S3 with PSRAM: Use 64KB (default) for best performance.
            For ESP32 without PSRAM: Use 24KB or 32KB to fit in limited SRAM.

            Smaller buffers may cause issues with very large tailnets (many peers).
            16KB is the minimum for basic operation.

    config MICROLINK_DEBUG_LOGGING
        bool "Enable debug logging"
        default n
        help
            Enable verbose debug logging for troubleshooting.

    config MICROLINK_ZERO_COPY_WG
        bool "Enable zero-copy WireGuard receive (high-throughput mode)"
        default n
        help
            Use raw lwIP UDP PCB instead of BSD sockets for WireGuard packet
            reception. This eliminates memory copies and reduces latency.

            Enable this for high-throughput applications like video streaming
            (30fps+). For typical IoT/sensor applications (heartbeats, commands),
            the default BSD socket mode is simpler and sufficient.

            Zero-copy mode contributed by dj-oyu (https://github.com/dj-oyu/microlink)

    menu "Custom Coordination Server"

        config MICROLINK_CUSTOM_COORD_SERVER
            bool "Use custom coordination server (Headscale/Ionscale)"
            default n
            help
                Enable to use a custom Tailscale-compatible coordination server
                instead of the official Tailscale control plane. Supports:
                - Headscale (https://github.com/juanfont/headscale)
                - Ionscale (https://github.com/jsiebens/ionscale)

        config MICROLINK_COORD_HOST
            string "Coordination server hostname"
            default "controlplane.tailscale.com"
            depends on MICROLINK_CUSTOM_COORD_SERVER
            help
                Hostname of your custom coordination server.
                Examples: "headscale.example.com", "ionscale.example.com"

        config MICROLINK_COORD_PORT
            int "Coordination server port"
            default 443
            range 1 65535
            depends on MICROLINK_CUSTOM_COORD_SERVER
            help
                Port of your custom coordination server (usually 443 for HTTPS).

    endmenu

endmenu
```

## examples/ping_pong_esp32/sdkconfig.defaults
```kconfig
# MicroLink Ping Pong Example - ESP32 (no PSRAM) optimized config
#
# This configuration is optimized for standard ESP32 boards without PSRAM
# such as HiLetgo ESP-32S, ESP32-WROOM-32D, ESP32-DevKitC, etc.
#
# Memory is tight! The 64KB coordination buffer will come from SRAM.
# Reduce MICROLINK_MAX_PEERS in menuconfig if you run out of memory.

# Required ESP-IDF components
CONFIG_ESP_TLS_USING_MBEDTLS=y
CONFIG_MBEDTLS_SSL_PROTO_TLS1_2=y
CONFIG_MBEDTLS_CERTIFICATE_BUNDLE=y
CONFIG_MBEDTLS_CERTIFICATE_BUNDLE_DEFAULT_CMN=y

# HTTP/2 support
CONFIG_ESP_HTTP_CLIENT_ENABLE_HTTPS=y
CONFIG_NGHTTP_ENABLE=y

# Networking - reduced buffer sizes for memory-constrained ESP32
CONFIG_LWIP_IPV4=y
CONFIG_LWIP_DHCP_DOES_ARP_CHECK=n
CONFIG_LWIP_IP4_FRAG=y
CONFIG_LWIP_IP4_REASSEMBLY=y
CONFIG_LWIP_TCP_MSS=1436
CONFIG_LWIP_TCP_SND_BUF_DEFAULT=4096
CONFIG_LWIP_TCP_WND_DEFAULT=4096
CONFIG_LWIP_TCP_RECVMBOX_SIZE=6
CONFIG_LWIP_UDP_RECVMBOX_SIZE=6

# Memory optimization for ESP32 without PSRAM
CONFIG_ESP_MAIN_TASK_STACK_SIZE=6144

# NO PSRAM - standard ESP32 uses SRAM only
# CONFIG_SPIRAM is intentionally NOT set

# MicroLink memory optimization for non-PSRAM ESP32
# 24KB buffer instead of 64KB to fit in limited SRAM (~266KB total)
CONFIG_MICROLINK_COORD_BUFFER_SIZE_KB=24
CONFIG_MICROLINK_MAX_PEERS=8

# Logging - reduce to INFO to save memory
CONFIG_LOG_DEFAULT_LEVEL_INFO=y
CONFIG_LOG_MAXIMUM_LEVEL_INFO=y

# Flash size and partition table
CONFIG_ESPTOOLPY_FLASHSIZE_4MB=y
CONFIG_PARTITION_TABLE_SINGLE_APP_LARGE=y

# WiFi - reduced buffers for memory optimization
CONFIG_ESP_WIFI_STATIC_RX_BUFFER_NUM=6
CONFIG_ESP_WIFI_DYNAMIC_RX_BUFFER_NUM=16
CONFIG_ESP_WIFI_TX_BUFFER_TYPE=1
CONFIG_ESP_WIFI_DYNAMIC_TX_BUFFER_NUM=16
CONFIG_ESP_WIFI_AMPDU_TX_ENABLED=n
CONFIG_ESP_WIFI_AMPDU_RX_ENABLED=n

# FreeRTOS
CONFIG_FREERTOS_HZ=1000

# mbedTLS memory optimization
CONFIG_MBEDTLS_ASYMMETRIC_CONTENT_LEN=y
CONFIG_MBEDTLS_SSL_IN_CONTENT_LEN=8192
CONFIG_MBEDTLS_SSL_OUT_CONTENT_LEN=4096
CONFIG_MBEDTLS_DYNAMIC_BUFFER=y
```

## examples/sensor_node/sdkconfig.defaults
```kconfig
# MicroLink Sensor Node Example - sdkconfig defaults

# Required ESP-IDF components
CONFIG_ESP_TLS_USING_MBEDTLS=y
CONFIG_MBEDTLS_SSL_PROTO_TLS1_2=y
CONFIG_MBEDTLS_CERTIFICATE_BUNDLE=y
CONFIG_MBEDTLS_CERTIFICATE_BUNDLE_DEFAULT_CMN=y

# HTTP/2 support
CONFIG_ESP_HTTP_CLIENT_ENABLE_HTTPS=y
CONFIG_NGHTTP_ENABLE=y

# Networking
CONFIG_LWIP_IPV4=y
CONFIG_LWIP_DHCP_DOES_ARP_CHECK=n
CONFIG_LWIP_IP4_FRAG=y
CONFIG_LWIP_IP4_REASSEMBLY=y
CONFIG_LWIP_TCP_MSS=1436
CONFIG_LWIP_TCP_SND_BUF_DEFAULT=5744
CONFIG_LWIP_TCP_WND_DEFAULT=5744

# Memory - PSRAM is REQUIRED for MicroLink (large buffers for MapResponse)
CONFIG_ESP_MAIN_TASK_STACK_SIZE=8192

# PSRAM / SPIRAM Configuration (required for ESP32-S3 with PSRAM)
CONFIG_SPIRAM=y
CONFIG_SPIRAM_MODE_OCT=y
CONFIG_SPIRAM_TYPE_AUTO=y
CONFIG_SPIRAM_SPEED_80M=y
CONFIG_SPIRAM_ALLOW_STACK_EXTERNAL_MEMORY=y
CONFIG_SPIRAM_MALLOC_ALWAYSINTERNAL=4096
CONFIG_SPIRAM_MALLOC_RESERVE_INTERNAL=32768

# Logging
CONFIG_LOG_DEFAULT_LEVEL_INFO=y
CONFIG_LOG_MAXIMUM_LEVEL_DEBUG=y

# Flash size and partition table
CONFIG_ESPTOOLPY_FLASHSIZE_4MB=y
CONFIG_PARTITION_TABLE_SINGLE_APP_LARGE=y

# WiFi
CONFIG_ESP_WIFI_STATIC_RX_BUFFER_NUM=10
CONFIG_ESP_WIFI_DYNAMIC_RX_BUFFER_NUM=32
CONFIG_ESP_WIFI_TX_BUFFER_TYPE=1
CONFIG_ESP_WIFI_DYNAMIC_TX_BUFFER_NUM=32

# FreeRTOS
CONFIG_FREERTOS_HZ=1000
```

## examples/udp_netcat_example/sdkconfig.defaults
```kconfig
# UDP Netcat Example - SDK Configuration Defaults
# Optimized for ESP32-S3 with PSRAM

# ESP32-S3 specific settings
CONFIG_IDF_TARGET="esp32s3"

# Main task stack
CONFIG_ESP_MAIN_TASK_STACK_SIZE=6144

# Enable PSRAM (required for ESP32-S3 with PSRAM)
CONFIG_ESP32S3_SPIRAM_SUPPORT=y
CONFIG_SPIRAM=y
CONFIG_SPIRAM_MODE_OCT=y
CONFIG_SPIRAM_SPEED_80M=y
CONFIG_SPIRAM_TRY_ALLOCATE_WIFI_LWIP=y
CONFIG_SPIRAM_MALLOC_ALWAYSINTERNAL=4096

# WiFi settings
CONFIG_ESP_WIFI_STATIC_RX_BUFFER_NUM=6
CONFIG_ESP_WIFI_DYNAMIC_RX_BUFFER_NUM=16
CONFIG_ESP_WIFI_TX_BUFFER_TYPE=0
CONFIG_ESP_WIFI_STATIC_TX_BUFFER_NUM=8
CONFIG_ESP_WIFI_AMPDU_TX_ENABLED=n
CONFIG_ESP_WIFI_AMPDU_RX_ENABLED=n

# lwIP settings
CONFIG_LWIP_MAX_SOCKETS=8
CONFIG_LWIP_TCP_SND_BUF_DEFAULT=2920
CONFIG_LWIP_TCP_WND_DEFAULT=2920
CONFIG_LWIP_TCP_RECVMBOX_SIZE=8
CONFIG_LWIP_UDP_RECVMBOX_SIZE=8
CONFIG_LWIP_TCPIP_RECVMBOX_SIZE=16

# mbedTLS settings
CONFIG_MBEDTLS_SSL_MAX_CONTENT_LEN=8192
CONFIG_MBEDTLS_HARDWARE_AES=y
CONFIG_MBEDTLS_HARDWARE_SHA=y
CONFIG_MBEDTLS_TLS_CLIENT_ONLY=y
CONFIG_MBEDTLS_SSL_KEEP_PEER_CERTIFICATE=n

# FreeRTOS
CONFIG_FREERTOS_TIMER_TASK_STACK_DEPTH=2048

# Compiler optimizations
CONFIG_COMPILER_OPTIMIZATION_SIZE=y
CONFIG_COMPILER_OPTIMIZATION_ASSERTIONS_SILENT=y

# Log level
CONFIG_LOG_DEFAULT_LEVEL_INFO=y
CONFIG_LOG_MAXIMUM_LEVEL_INFO=y

# Flash size
CONFIG_ESPTOOLPY_FLASHSIZE_8MB=y

# Custom partition table
CONFIG_PARTITION_TABLE_CUSTOM=y
CONFIG_PARTITION_TABLE_CUSTOM_FILENAME="partitions.csv"

# Disable unused features
CONFIG_VFS_SUPPORT_TERMIOS=n
CONFIG_NEWLIB_NANO_FORMAT=y
```

## sdkconfig.defaults
```kconfig
# PSRAM - Octal mode for ESP32-S3-N16R8 (8MB)
CONFIG_SPIRAM=y
CONFIG_SPIRAM_MODE_OCT=y
CONFIG_SPIRAM_TYPE_AUTO=y
CONFIG_SPIRAM_SPEED_80M=y
CONFIG_SPIRAM_ALLOW_STACK_EXTERNAL_MEMORY=y
CONFIG_SPIRAM_MALLOC_ALWAYSINTERNAL=4096
CONFIG_SPIRAM_MALLOC_RESERVE_INTERNAL=32768

# Flash size - 16MB
CONFIG_ESPTOOLPY_FLASHSIZE_16MB=y
CONFIG_ESPTOOLPY_FLASHSIZE="16MB"

# Partition table
CONFIG_PARTITION_TABLE_SINGLE_APP_LARGE=y

# TLS/HTTPS
CONFIG_ESP_TLS_USING_MBEDTLS=y
CONFIG_MBEDTLS_SSL_PROTO_TLS1_2=y
CONFIG_MBEDTLS_CERTIFICATE_BUNDLE=y
CONFIG_MBEDTLS_CERTIFICATE_BUNDLE_DEFAULT_CMN=y

# Networking
CONFIG_LWIP_IPV4=y
CONFIG_LWIP_IP4_FRAG=y
CONFIG_LWIP_IP4_REASSEMBLY=y

# Stack size - increased significantly
CONFIG_ESP_MAIN_TASK_STACK_SIZE=32768

# MicroLink - DISCO port
CONFIG_MICROLINK_DISCO_PORT=51821
```
